macro_control_center: macro_control_center{
compatible = "zmk,behavior-macro";
label = "macro_control_center";
#binding-cells = <0>;
bindings = <&kp RCTRL>, <&kp UP_ARROW>;
};
macro_app_windows: macro_app_windows{
compatible = "zmk,behavior-macro";
label = "macro_app_windows";
#binding-cells = <0>;
bindings = <&kp RCTRL>, <&kp DOWN_ARROW>;
};
macro_quotes: macro_quotes{
compatible = "zmk,behavior-macro";
label = "macro_quotes";
#binding-cells = <0>;
bindings = <&kp SQT>, <&kp SQT>, <&kp LEFT>;
};